## Kconfig
```kconfig
# SPDX-License-Identifier: MIT

config ZMK_SPLIT_CHARGING
    bool "Share each half's USB-power (charging) state with the central"
    default y
    depends on ZMK_SPLIT && ZMK_SPLIT_BLE && SOC_SERIES_NRF52X
    help
      Peripherals watch VBUS and expose it over a small GATT service; the
      central subscribes and raises zmk_split_charging_state_changed so the
      dongle screen can show which half is charging.

config ZMK_SPLIT_CHARGING_POLL_MS
    int "How often a peripheral checks for USB power (ms)"
    default 3000
    depends on ZMK_SPLIT_CHARGING && !ZMK_SPLIT_ROLE_CENTRAL

config ZMK_USB_1200_BAUD_BOOTLOADER
    bool "Reboot into the UF2 bootloader on a 1200 baud touch"
    depends on USB_CDC_ACM && SOC_SERIES_NRF52X
    select CDC_ACM_DTE_RATE_CALLBACK_SUPPORT
    help
      When the host sets the CDC ACM port to 1200 baud (stty -F /dev/ttyACM0 1200),
      reboot with the Adafruit UF2 magic so NICENANO mounts without pressing reset.
```

## dts/bindings/zmk,dongle-screen-touch-gestures.yaml
```yaml
# SPDX-License-Identifier: MIT

description: |
  Turns touches on the dongle screen's touch panel into gestures and runs a
  ZMK behavior for each one. `bindings` must list exactly 7 behaviors, in order:
  tap, double-tap, long-press, swipe-up, swipe-down, swipe-left, swipe-right.
  Use &none for gestures you don't want.

compatible: "zmk,dongle-screen-touch-gestures"

properties:
  input:
    type: phandle
    required: true
    description: Touch input device (e.g. a hynitron,cst816s node)

  bindings:
    type: phandle-array
    required: true

  swap-xy:
    type: boolean
    description: Swap raw X/Y so they match the screen's orientation

  invert-x:
    type: boolean
    description: Invert X (after swap)

  invert-y:
    type: boolean
    description: Invert Y (after swap)
```
